## boards/shields/ergoboard/Kconfig.defconfig
```kconfig
if SHIELD_ERGB

config ZMK_KEYBOARD_NAME
  default "ERGB"

config ZMK_SPLIT_ROLE_CENTRAL
  default y

endif

if SHIELD_ERGB_LEFT || SHIELD_ERGB_LEFT

config ZMK_SPLIT
  default y

endif
```

## outputs/Kconfig/Kconfig.shield
```kconfig
osource "../../ergo-board/boards/shields/*/Kconfig.shield"
osource "/Users/alexandergmiles/zmk/zmk/app/boards/shields/*/Kconfig.shield"
```

## outputs/Kconfig/Kconfig.shield.defconfig
```kconfig
osource "../../ergo-board/boards/shields/*/Kconfig.defconfig"
osource "/Users/alexandergmiles/zmk/zmk/app/boards/shields/*/Kconfig.defconfig"
```
